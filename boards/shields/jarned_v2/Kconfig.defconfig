## boards/shields/jarned_v2/Kconfig.defconfig
```kconfig
if SHIELD_JARNED_V2_LEFT

config ZMK_KEYBOARD_NAME
    default "Jarned-V2"

config ZMK_SPLIT_ROLE_CENTRAL
    default y

endif # SHIELD_JARNED_V2_LEFT

if SHIELD_JARNED_V2_LEFT || SHIELD_JARNED_V2_RIGHT

config ZMK_SPLIT
    default y

endif # SHIELD_JARNED_V2_LEFT || SHIELD_JARNED_V2_RIGHT
```

## boards/shields/jarned_v2/Kconfig.shield
```kconfig
config SHIELD_JARNED_V2_LEFT
    def_bool $(shields_list_contains,jarned_v2_left)

config SHIELD_JARNED_V2_RIGHT
    def_bool $(shields_list_contains,jarned_v2_right)
```
